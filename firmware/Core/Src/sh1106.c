#include "sh1106.h"

#include <string.h>

#include "i2c.h"

#define ADDR          (0x3Cu << 1)
#define CTRL_CMD      0x00u
#define CTRL_DATA     0x40u
#define COL_OFFSET    2u      /* SH1106 RAM is 132 wide, the glass is centred */
#define I2C_TIMEOUT   10u
#define RETRY_MS      2000u

static uint8_t  fb[OLED_W * OLED_H / 8];
static uint8_t  pending;      /* bitmask of pages still to send */
static uint8_t  next_page;
static bool     online;
static uint32_t retry_at;

/* Classic 5x7 font, ASCII 0x20..0x7E, plus a degree sign at 0x7F. Each glyph
 * is five columns, LSB at the top. */
static const uint8_t font[][5] = {
  {0x00,0x00,0x00,0x00,0x00}, {0x00,0x00,0x5F,0x00,0x00}, {0x00,0x07,0x00,0x07,0x00}, {0x14,0x7F,0x14,0x7F,0x14},
  {0x24,0x2A,0x7F,0x2A,0x12}, {0x23,0x13,0x08,0x64,0x62}, {0x36,0x49,0x55,0x22,0x50}, {0x00,0x05,0x03,0x00,0x00},
  {0x00,0x1C,0x22,0x41,0x00}, {0x00,0x41,0x22,0x1C,0x00}, {0x08,0x2A,0x1C,0x2A,0x08}, {0x08,0x08,0x3E,0x08,0x08},
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  {0x00,0x00,0x7F,0x00,0x00}, {0x00,0x41,0x36,0x08,0x00}, {0x10,0x08,0x08,0x10,0x08}, {0x00,0x06,0x09,0x09,0x06},
};

_Static_assert(sizeof font / sizeof font[0] == 0x80 - 0x20, "font must cover 0x20..0x7F");

static bool send(uint8_t ctrl, const uint8_t *data, uint16_t len)
{
  return HAL_I2C_Mem_Write(&hi2c1, ADDR, ctrl, I2C_MEMADD_SIZE_8BIT, (uint8_t *)data, len, I2C_TIMEOUT) == HAL_OK;
}

static bool send_page(uint8_t page)
{
  const uint8_t cmd[3] = {(uint8_t)(0xB0u | page), COL_OFFSET & 0x0Fu, 0x10u | (COL_OFFSET >> 4)};
  return send(CTRL_CMD, cmd, sizeof cmd) && send(CTRL_DATA, &fb[page * OLED_W], OLED_W);
}

bool sh1106_init(void)
{
  static const uint8_t seq[] = {
    0xAE,             /* display off */
    0xD5, 0x80,       /* clock divide */
    0xA8, 0x3F,       /* multiplex 64 */
    0xD3, 0x00,       /* display offset */
    0x40,             /* start line 0 */
    0xAD, 0x8B,       /* DC-DC on */
    0xA1,             /* segment remap */
    0xC8,             /* COM scan descending */
    0xDA, 0x12,       /* COM pins */
    0x81, 0xCF,       /* contrast */
    0xD9, 0xF1,       /* precharge */
    0xDB, 0x40,       /* VCOMH */
    0xA4,             /* follow RAM */
    0xA6,             /* not inverted */
    0xAF,             /* display on */
  };
  online   = send(CTRL_CMD, seq, sizeof seq);
  retry_at = HAL_GetTick() + RETRY_MS;
  pending  = 0xFF;
  return online;
}

void sh1106_clear(void) { memset(fb, 0, sizeof fb); }

void sh1106_pixel(int x, int y, Ink ink)
{
  if ((unsigned)x >= OLED_W || (unsigned)y >= OLED_H) return;
  uint8_t *b   = &fb[(y >> 3) * OLED_W + x];
  uint8_t  bit = (uint8_t)(1u << (y & 7));
  if (ink == INK_ON) *b |= bit;
  else if (ink == INK_OFF) *b &= (uint8_t)~bit;
  else *b ^= bit;
}

void sh1106_hline(int x, int y, int w, Ink ink)
{
  for (int i = 0; i < w; i++) sh1106_pixel(x + i, y, ink);
}

void sh1106_vline(int x, int y, int h, Ink ink)
{
  for (int i = 0; i < h; i++) sh1106_pixel(x, y + i, ink);
}

void sh1106_frame(int x, int y, int w, int h, Ink ink)
{
  if (w <= 0 || h <= 0) return;
  sh1106_hline(x, y, w, ink);
  sh1106_hline(x, y + h - 1, w, ink);
  sh1106_vline(x, y + 1, h - 2, ink);
  sh1106_vline(x + w - 1, y + 1, h - 2, ink);
}

void sh1106_box(int x, int y, int w, int h, Ink ink)
{
  for (int j = 0; j < h; j++) sh1106_hline(x, y + j, w, ink);
}

void sh1106_disc(int cx, int cy, int r, Ink ink)
{
  for (int dy = -r; dy <= r; dy++) {
    int dx = 0;
    while ((dx + 1) * (dx + 1) + dy * dy <= r * r) dx++;
    sh1106_hline(cx - dx, cy + dy, 2 * dx + 1, ink);
  }
}

void sh1106_circle(int cx, int cy, int r, Ink ink)
{
  int x = r, y = 0, err = 1 - r;
  while (x >= y) {
    sh1106_pixel(cx + x, cy + y, ink); sh1106_pixel(cx - x, cy + y, ink);
    sh1106_pixel(cx + x, cy - y, ink); sh1106_pixel(cx - x, cy - y, ink);
    sh1106_pixel(cx + y, cy + x, ink); sh1106_pixel(cx - y, cy + x, ink);
    sh1106_pixel(cx + y, cy - x, ink); sh1106_pixel(cx - y, cy - x, ink);
    y++;
    if (err < 0) err += 2 * y + 1;
    else { x--; err += 2 * (y - x) + 1; }
  }
}

int sh1106_text(int x, int y, const char *s, int scale, Ink ink)
{
  for (; *s; s++) {
    unsigned char ch = (unsigned char)*s;
    if (ch < 0x20 || ch > 0x7F) ch = '?';
    const uint8_t *g = font[ch - 0x20];
    for (int col = 0; col < 5; col++)
      for (int row = 0; row < 7; row++)
        if (g[col] & (1u << row))
          for (int sy = 0; sy < scale; sy++)
            for (int sx = 0; sx < scale; sx++) sh1106_pixel(x + col * scale + sx, y + row * scale + sy, ink);
    x += 6 * scale;
  }
  return x;
}

int sh1106_text_width(const char *s, int scale) { return (int)strlen(s) * 6 * scale - scale; }

void sh1106_present(void) { pending = 0xFF; }

bool sh1106_flush_step(void)
{
  if (!online) {
    /* Display missing or the bus glitched: try again later, don't stall. */
    if ((int32_t)(HAL_GetTick() - retry_at) >= 0) {
      /* A stuck bus leaves the peripheral busy forever, so start it fresh. */
      HAL_I2C_DeInit(&hi2c1);
      MX_I2C1_Init();
      sh1106_init();
    }
    return false;
  }
  for (int n = 0; n < 8 && pending; n++) {
    uint8_t page = next_page;
    next_page = (uint8_t)((next_page + 1u) & 7u);
    if (pending & (1u << page)) {
      pending &= (uint8_t)~(1u << page);
      if (!send_page(page)) {
        online   = false;
        retry_at = HAL_GetTick() + RETRY_MS;
      }
      break;
    }
  }
  return pending != 0;
}

void sh1106_flush_all(void)
{
  sh1106_present();
  for (int i = 0; i < 8 && online; i++) sh1106_flush_step();
}
